/*
 * Copyright (C) 2016-2019 Variscite Ltd. - https://www.variscite.com
 *
 * This program is free software; you can redistribute it and/or modify
 * it under the terms of the GNU General Public License version 2 as
 * published by the Free Software Foundation.
 */

/dts-v1/;

#include "magi_mpuprotoboard.dtsi"

/ {
	model = "MAGI MPU Prototype Board";
	compatible = "variscite,imx6ul-var-dart", "fsl,imx6ull";
};
